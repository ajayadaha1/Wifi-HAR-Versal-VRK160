## petalinux/project-spec/configs/configs/Kconfig
```kconfig
mainmenu "PetaLinux System Configuration"
config SUBSYSTEM_TYPE_LINUX
        bool
        default y
        select SYSTEM_VERSAL

config SYSTEM_VERSAL
        bool "VERSAL Configuration"
        help
          VERSAL Configuration for the project.
          All these config options will be in /group/bcapps/ajayad/master_thesis_rebirth/WiFi-HAR-VRK160/petalinux/project-spec/configs/config

config SUBSYSTEM_SDT_FLOW
        bool
        default y
        help

config SUBSYSTEM_DISTRO_PETALINUX
        bool
        default y
        help

source /group/bcapps/ajayad/master_thesis_rebirth/WiFi-HAR-VRK160/petalinux/project-spec/configs/configs/Kconfig.main
```

## petalinux/project-spec/configs/rootfsconfigs/Kconfig.user
```kconfig
menu "user packages " 
config gpio-demo  
	 bool "gpio-demo"
	 help
	
config peekpoke  
	 bool "peekpoke"
	 help
	
config wifi-har  
	 bool "wifi-har"
	 help
	
endmenu
```
